## firmware/main/Kconfig.projbuild
```kconfig
menu "WiFi Configuration"

config WIFI_SSID
    string "WiFi SSID"
    default "myssid"
    help
	SSID (network name) for the example to connect to.

config WIFI_PASSWORD
    string "WiFi Password"
    default "mypassword"
    help
	WiFi password (WPA or WPA2) for the example to use.

endmenu

menu "Server Configuration"

config SERVER_IP
    string "Server IP"
    default "192.168.1.2"
    help
	IP of the server (Check ipconfig if on windows, ifconfig if on linux, may God have mercy if you have a mac).

endmenu

menu "Debug Mode"

config WEB_SERVER_ONLY
    bool "Web Server Only"
    help
	Debug mode with only web server active

endmenu
```
